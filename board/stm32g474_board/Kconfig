## board/stm32g474_board/Kconfig
```kconfig
mainmenu "Logger Configuration"

rsource "main/bsp/Kconfig"
rsource "main/filesystem/Kconfig"
```

## board/stm32g474_board/configs/fatfs_defconfig
```kconfig
#
# Board Support Package
#

#
# Clock
#
CONFIG_CORE_FREQ_160MHZ=y
CONFIG_CORE_FREQ=160000000
# CONFIG_APB2_DIV_1 is not set
# CONFIG_APB2_DIV_2 is not set
CONFIG_APB2_DIV_4=y
# CONFIG_APB2_DIV_8 is not set
# CONFIG_APB2_DIV_16 is not set
CONFIG_APB2_PERIPH_FREQ=40000000
# end of Clock

CONFIG_LOG_LEVEL_DEBUG=0
CONFIG_LOG_LEVEL_INFO=1
CONFIG_LOG_LEVEL_WARNING=2
CONFIG_LOG_LEVEL_ERROR=3
CONFIG_LOG_LEVEL_OFF=4
CONFIG_USE_SDCARD=y
CONFIG_SDCARD_HAS_DETECT_PIN=y
CONFIG_SDCARD_DETECT_ACTIVE_HIGH=y
CONFIG_SDCARD_HAS_POWER_SWITCH=y
CONFIG_SDCARD_POWER_SWITCH_ACTIVE_HIGH=y
# CONFIG_SDCARD_SPI_FREQ_20MHZ is not set
CONFIG_SDCARD_SPI_FREQ_10MHZ=y
# CONFIG_SDCARD_SPI_FREQ_5MHZ is not set
# CONFIG_SDCARD_SPI_FREQ_2500KHZ is not set
# CONFIG_SDCARD_SPI_FREQ_1250KHZ is not set
# CONFIG_SDCARDSPI_FREQ_625KHZ is not set
# CONFIG_SDCARD_SPI_FREQ_312KHZ is not set
# CONFIG_SDCARD_SPI_FREQ_156KHZ is not set
CONFIG_SDCARD_SPI_FREQ_IDX=1
CONFIG_USE_SPI=y
CONFIG_SPI_TEST=y
CONFIG_USE_CAN=y
CONFIG_CAN_COUNT=3

#
# CAN1
#
# CONFIG_FD_CAN_ONE is not set
# CONFIG_DATA_500KHZ_CAN_ONE is not set
CONFIG_DATA_1MHZ_CAN_ONE=y
CONFIG_DATA_BPS_CAN_ONE=1
CONFIG_ARBIT_BPS_CAN_ONE=1
# end of CAN1

#
# CAN2
#
# CONFIG_FD_CAN_TWO is not set
# CONFIG_DATA_500KHZ_CAN_TWO is not set
CONFIG_DATA_1MHZ_CAN_TWO=y
CONFIG_DATA_BPS_CAN_TWO=1
CONFIG_ARBIT_BPS_CAN_TWO=1
# end of CAN2

#
# CAN3
#
# CONFIG_FD_CAN_THREE is not set
# CONFIG_DATA_500KHZ_CAN_THREE is not set
CONFIG_DATA_1MHZ_CAN_THREE=y
CONFIG_DATA_BPS_CAN_THREE=1
CONFIG_ARBIT_BPS_CAN_THREE=1
# end of CAN3

# CONFIG_CAN_LOG_OFF is not set
CONFIG_CAN_LOG_DEBUG=y
# CONFIG_CAN_LOG_INFO is not set
# CONFIG_CAN_LOG_WARNING is not set
# CONFIG_CAN_LOG_ERROR is not set
CONFIG_CAN_LOG_LEVEL=0
# end of Board Support Package

# CONFIG_USE_LFS_SD is not set
```

## board/stm32g474_board/configs/logger_defconfig
```kconfig
#
# Board Support Package
#

#
# Clock
#
CONFIG_CORE_FREQ_160MHZ=y
CONFIG_CORE_FREQ=160000000
# CONFIG_APB2_DIV_1 is not set
# CONFIG_APB2_DIV_2 is not set
CONFIG_APB2_DIV_4=y
# CONFIG_APB2_DIV_8 is not set
# CONFIG_APB2_DIV_16 is not set
CONFIG_APB2_PERIPH_FREQ=40000000
# end of Clock

CONFIG_LOG_LEVEL_DEBUG=0
CONFIG_LOG_LEVEL_INFO=1
CONFIG_LOG_LEVEL_WARNING=2
CONFIG_LOG_LEVEL_ERROR=3
CONFIG_LOG_LEVEL_OFF=4
CONFIG_USE_SDCARD=y
CONFIG_SDCARD_HAS_DETECT_PIN=y
CONFIG_SDCARD_DETECT_ACTIVE_HIGH=y
# CONFIG_SDCARD_SPI_FREQ_20MHZ is not set
# CONFIG_SDCARD_SPI_FREQ_10MHZ is not set
# CONFIG_SDCARD_SPI_FREQ_5MHZ is not set
# CONFIG_SDCARD_SPI_FREQ_2500KHZ is not set
# CONFIG_SDCARD_SPI_FREQ_1250KHZ is not set
# CONFIG_SDCARDSPI_FREQ_625KHZ is not set
CONFIG_SDCARD_SPI_FREQ_312KHZ=y
# CONFIG_SDCARD_SPI_FREQ_156KHZ is not set
CONFIG_SDCARD_SPI_FREQ_IDX=6
CONFIG_USE_SPI=y
CONFIG_SPI_TEST=y
CONFIG_USE_CAN=y
CONFIG_CAN_COUNT=1

#
# CAN1
#
# CONFIG_FD_CAN_ONE is not set
# CONFIG_DATA_500KHZ_CAN_ONE is not set
CONFIG_DATA_1MHZ_CAN_ONE=y
CONFIG_DATA_BPS_CAN_ONE=1
CONFIG_ARBIT_BPS_CAN_ONE=1
# end of CAN1

# CONFIG_CAN_LOG_OFF is not set
CONFIG_CAN_LOG_DEBUG=y
# CONFIG_CAN_LOG_INFO is not set
# CONFIG_CAN_LOG_WARNING is not set
# CONFIG_CAN_LOG_ERROR is not set
CONFIG_CAN_LOG_LEVEL=0
# end of Board Support Package

CONFIG_USE_LFS_SD=y

#
# Log
#
# CONFIG_LFS_LOG_TRACE is not set
# end of Log

CONFIG_TEST_LFS_SD=y
```

## board/stm32g474_board/main/bsp/Kconfig
```kconfig
menu "Board Support Package"
    menu "Clock"
        choice
            prompt "Core Frequency"
            default CORE_FREQ_160MHZ
            config CORE_FREQ_160MHZ
                bool "160MHz"
        endchoice
        config CORE_FREQ
            int
            default 160000000 if CORE_FREQ_160MHZ
        choice
            prompt "APB2 Prescaler"
            config APB2_DIV_1
                bool "/1"
            config APB2_DIV_2
                bool "/2"
            config APB2_DIV_4
                bool "/4"
            config APB2_DIV_8
                bool "/8"
            config APB2_DIV_16
                bool "/16"
        endchoice
        config APB2_PERIPH_FREQ
            int
            default 160000000 if APB2_DIV_1
            default  80000000 if APB2_DIV_2
            default  40000000 if APB2_DIV_4
            default  20000000 if APB2_DIV_8
            default  10000000 if APB2_DIV_16
    endmenu # "Clock"

    config LOG_LEVEL_DEBUG
        int
        default 0
    config LOG_LEVEL_INFO
        int
        default 1
    config LOG_LEVEL_WARNING
        int
        default 2
    config LOG_LEVEL_ERROR
        int
        default 3
    config LOG_LEVEL_OFF
        int
        default 4

    rsource "sdcard/Kconfig"
    rsource "spi/Kconfig"
    rsource "can/Kconfig"

endmenu # "Board Support Package"
```

## board/stm32g474_board/main/bsp/can/Kconfig
```kconfig
menuconfig USE_CAN
    bool "CAN-STD/FD"
    default y
    
    if USE_CAN
        config CAN_COUNT
            int "Instance"
            default 3
        menu "CAN1"
            depends on CAN_COUNT >= 1
            config FD_CAN_ONE
                bool "Flexible Data Rate (FD)"
                default n
            config BRS_CAN_ONE
                depends on FD_CAN_ONE
                bool "Bit Rate Switching (BRS)"
                default y
            choice
                prompt "Data Bit Rate"
                config DATA_500KHZ_CAN_ONE
                    bool "500kbps"
                config DATA_1MHZ_CAN_ONE
                    bool "1Mbps"
                config DATA_2MHZ_CAN_ONE
                    depends on BRS_CAN_ONE
                    bool "2Mbps"
            endchoice
            config DATA_BPS_CAN_ONE
                int
                default 0 if DATA_500KHZ_CAN_ONE
                default 1 if DATA_1MHZ_CAN_ONE
                default 2 if DATA_2MHZ_CAN_ONE
            choice
                depends on BRS_CAN_ONE
                prompt "Arbitration Data Rate"
                config ARBIT_500KHZ_CAN_ONE
                    bool "500kbps"
                config ARBIT_1MHZ_CAN_ONE
                    bool "1Mbps"
            endchoice
            config ARBIT_BPS_CAN_ONE
                int
                default 0 if ARBIT_500KHZ_CAN_ONE
                default 1 if ARBIT_1MHZ_CAN_ONE
                default 1
        endmenu # CAN1
        menu "CAN2"
            depends on CAN_COUNT >= 2
            config FD_CAN_TWO
                bool "Flexible Data Rate (FD)"
                default n
            config BRS_CAN_TWO
                depends on FD_CAN_TWO
                bool "Bit Rate Switching (BRS)"
                default y
            choice
                prompt "Data Bit Rate"
                config DATA_500KHZ_CAN_TWO
                    bool "500kbps"
                config DATA_1MHZ_CAN_TWO
                    bool "1Mbps"
                config DATA_2MHZ_CAN_TWO
                    depends on BRS_CAN_TWO
                    bool "2Mbps"
            endchoice
            config DATA_BPS_CAN_TWO
                int
                default 0 if DATA_500KHZ_CAN_TWO
                default 1 if DATA_1MHZ_CAN_TWO
                default 2 if DATA_2MHZ_CAN_TWO
            choice
                depends on BRS_CAN_TWO
                prompt "Arbitration Data Rate"
                config ARBIT_500KHZ_CAN_TWO
                    bool "500kbps"
                config ARBIT_1MHZ_CAN_TWO
                    bool "1Mbps"
            endchoice
            config ARBIT_BPS_CAN_TWO
                int
                default 0 if ARBIT_500KHZ_CAN_TWO
                default 1 if ARBIT_1MHZ_CAN_TWO
                default 1
        endmenu # CAN2
        menu "CAN3"
            depends on CAN_COUNT >= 3
            config FD_CAN_THREE
                bool "Flexible Data Rate (FD)"
                default n
            config BRS_CAN_THREE
                depends on FD_CAN_THREE
                bool "Bit Rate Switching (BRS)"
                default y
            choice
                prompt "Data Bit Rate"
                config DATA_500KHZ_CAN_THREE
                    bool "500kbps"
                config DATA_1MHZ_CAN_THREE
                    bool "1Mbps"
                config DATA_2MHZ_CAN_THREE
                    depends on BRS_CAN_THREE
                    bool "2Mbps"
            endchoice
            config DATA_BPS_CAN_THREE
                int
                default 0 if DATA_500KHZ_CAN_THREE
                default 1 if DATA_1MHZ_CAN_THREE
                default 2 if DATA_2MHZ_CAN_THREE
            choice
                depends on BRS_CAN_THREE
                prompt "Arbitration Data Rate"
                config ARBIT_500KHZ_CAN_THREE
                    bool "500kbps"
                config ARBIT_1MHZ_CAN_THREE
                    bool "1Mbps"
            endchoice
            config ARBIT_BPS_CAN_THREE
                int
                default 0 if ARBIT_500KHZ_CAN_THREE
                default 1 if ARBIT_1MHZ_CAN_THREE
                default 1
        endmenu # CAN3

        choice
            prompt "Log level"
            config CAN_LOG_OFF
                bool "Off"
            config CAN_LOG_DEBUG
                bool "Debug"
            config CAN_LOG_INFO
                bool "Info"
            config CAN_LOG_WARNING
                bool "Warning"
            config CAN_LOG_ERROR
                bool "Error"
        endchoice

        config CAN_LOG_LEVEL
            int
            default 0 if CAN_LOG_DEBUG
            default 1 if CAN_LOG_INFO
            default 2 if CAN_LOG_WARNING
            default 3 if CAN_LOG_ERROR
            default 4 if CAN_LOG_OFF

    endif # USE_CAN
```

## board/stm32g474_board/main/bsp/sdcard/Kconfig
```kconfig
menuconfig USE_SDCARD
    depends on USE_SPI
    bool "SD Card"
    
    if USE_SDCARD
        config SDCARD_HAS_DETECT_PIN
            bool "Detect Pin"
            default y
        choice
            prompt "SPI clock frequency"
            default SDCARD_SPI_FREQ_1250MHZ
            config SDCARD_SPI_FREQ_20MHZ
                bool "20MHz"
            config SDCARD_SPI_FREQ_10MHZ
                bool "10MHz"
            config SDCARD_SPI_FREQ_5MHZ
                bool "5MHz"
            config SDCARD_SPI_FREQ_2500KHZ
                bool "2.5MHz"
            config SDCARD_SPI_FREQ_1250KHZ
                bool "1.25MHz"
            config SDCARDSPI_FREQ_625KHZ
                bool "625kHz"
            config SDCARD_SPI_FREQ_312KHZ
                bool "312.5kHz"
            config SDCARD_SPI_FREQ_156KHZ
                bool "156.25kHz"
        endchoice
        config SDCARD_SPI_FREQ_IDX
            int
            default 0 if SDCARD_SPI_FREQ_20MHZ
            default 1 if SDCARD_SPI_FREQ_10MHZ
            default 2 if SDCARD_SPI_FREQ_5MHZ
            default 3 if SDCARD_SPI_FREQ_2500KHZ
            default 4 if SDCARD_SPI_FREQ_1250KHZ
            default 5 if SDCARDSPI_FREQ_625KHZ
            default 6 if SDCARD_SPI_FREQ_312KHZ
            default 7 if SDCARD_SPI_FREQ_156KHZ
            default 7
    endif # USE_SDCARD
```

## board/stm32g474_board/main/bsp/spi/Kconfig
```kconfig
menuconfig USE_SPI
    bool "SPI"
    default y

    if USE_SPI
        config SPI_TEST
            bool "Test"
            default y
    endif # USE_SPI
```

## board/stm32g474_board/main/filesystem/Kconfig
```kconfig
menuconfig USE_FILESYSTEM
    depends on USE_SDCARD
    bool "Filesystem"
    
    if USE_FILESYSTEM
        choice
            prompt "Type"
            config USE_LFS_SD
                bool "LittleFS"
            config USE_FATFS_SD
                bool "FatFS"
        endchoice

        rsource "FatFs_sd/Kconfig"
    endif # USE_FILESYSTEM

#    menu "Log"
#        config LFS_LOG_TRACE
#            bool "Trace"
#            default n
#    endmenu
#    config TEST_LFS_SD
#        bool "Test Commands"
#        default y
```
