## board/stm32g474_board/main/filesystem/FatFs_sd/Kconfig
```kconfig
menu "FatFS"
    depends on USE_FATFS_SD

    menuconfig TEST_FATFS_SD
        bool "Test commands"
        default y
        
        if TEST_FATFS_SD
            config FATFS_CMD_FORMAT
                bool "fatfs_format"
                default n
            config FATFS_CMD_MOUNT
                bool "fatfs_mount"
                default y
            config FATFS_CMD_INFO
                depends on FATFS_CMD_MOUNT
                bool "fatfs_info"
                default y
            config FATFS_CMD_LS
                depends on FATFS_CMD_MOUNT
                bool "fatfs_ls"
                default y
            config FATFS_CMD_FOPEN
                depends on FATFS_CMD_MOUNT
                bool "fatfs_fopen"
                default y
            config FATFS_CMD_FCLOSE
                depends on FATFS_CMD_FOPEN
                bool "fatfs_fclose"
                default y
            config FATFS_CMD_FREAD
                depends on FATFS_CMD_FOPEN
                bool "fatfs_fread"
                default y
            config FATFS_CMD_FWRITE
                depends on FATFS_CMD_FOPEN
                bool "fatfs_fwrite"
                default y
        endif # TEST_FATFS_SD
endmenu
```
